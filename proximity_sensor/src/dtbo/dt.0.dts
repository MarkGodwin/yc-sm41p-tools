/dts-v1/;
/plugin/;
/ {

	fragment@0 {
		target = <&chosen>;

		__overlay__ {
			bootargs_ext = "androidboot.boot_devices=fe310000.sdhci,fe330000.nandc";
		};
	};

	fragment@1 {
		target = <&reboot_mode>;

		__overlay__ {
			mode-bootloader = <0x5242c309>;
			mode-charge = <0x5242c30b>;
			mode-fastboot = <0x5242c303>;
			mode-loader = <0x5242c301>;
			mode-normal = <0x5242c300>;
			mode-recovery = <0x5242c303>;
		};
	};

	fragment@2 {
		target = <&i2c3>;

		__overlay__ {
			ps_em3071x@24 {
				compatible = "ps_em3071x";
	                        reg = <0x24>;
        	                type = <0x06>;
                	        irq_enable = <0x00>;
                        	poll_delay_ms = <0x64>;
	                        status = "okay";
        	                ps_threshold_low = <0x18>;
                	        ps_threshold_high = <0xd8>;
                        	ps_offset = <0x05>;
                                ps_power = <0x05>;
	                };
		};
	};

};
